## layers/bsp/meta-laird/conf/layer.conf
```bitbake
# We have a conf and classes directory, append to BBPATH
BBPATH .= ":${LAYERDIR}"

# We have a recipes directory, add to BBFILES
BBFILES += "${LAYERDIR}/recipes*/*/*.bb ${LAYERDIR}/recipes*/*/*.bbappend"

BBFILE_COLLECTIONS += "laird"
BBFILE_PATTERN_laird := "^${LAYERDIR}/"

LICENSE_PATH += "${LAYERDIR}/licenses"

BBFILES += "${@' '.join('${LAYERDIR}/%s/recipes*/*/*.bbappend' % layer \
               for layer in BBFILE_COLLECTIONS.split())}"
BBFILES += "${@' '.join('${LAYERDIR}/%s/recipes*/*/*.bb' % layer \
               for layer in BBFILE_COLLECTIONS.split())}"

LAYERDEPENDS_laird = "core"
```

## layers/bsp/meta-laird/conf/machine/rg1xx-sd.conf
```bitbake
#@TYPE: Machine
#@Name: Laird WB50N module
#@DESCRIPTION: Machine configuration for Laird WB50N module

require include/sama5d3.inc

MACHINE_FEATURES = "apm ext2 ext3 usbhost usbgadget wifi"
KERNEL_DEVICETREE = "at91-wb50n.dtb"

# used by sysvinit_2
SERIAL_CONSOLES ?= "115200;ttyS0 115200;ttyGS0"

IMAGE_FSTYPES += " tar.bz2 ext3"
SDIMG_COMPRESSION ?= "gzip"

UBOOT_MACHINE ?= "wb50n_mmc_defconfig"
UBOOT_ENTRYPOINT = "0x20008000"
UBOOT_LOADADDRESS = "0x20008000"

AT91BOOTSTRAP_MACHINE ?= "wb50n"

IMAGE_BOOT_FILES = "u-boot.bin BOOT.BIN"
```
